## drivers/char/sunxi_mem/Kconfig
```kconfig
#
# sunxi continous physic memory allocator.
#

config SUNXI_PHYS_MEM_ALLOCATOR
	tristate "sunxi continous physic memory allocator"
	default y
	help
	Nothing help.
```
